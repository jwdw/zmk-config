## boards/shields/reviung/Kconfig.defconfig
```kconfig
if SHIELD_REVIUNG_DONGLE

# Max 16 characters in keyboard name
config ZMK_KEYBOARD_NAME
    default "My Board"

config ZMK_SPLIT_ROLE_CENTRAL
    default y

config ZMK_SPLIT
    default y

endif
```

## boards/shields/reviung/Kconfig.shield
```kconfig
# No whitespace after the comma or in the keyboard name!
config SHIELD_REVIUNG_DONGLE
    def_bool $(shields_list_contains,reviung_dongle)
```

## boards/shields/splitkb_aurora_sweep/Kconfig.shield
```kconfig
# No whitespace after the comma or in the keyboard name!
config SHIELD_SPLITKB_AURORA_SWEEP_DONGLE
    def_bool $(shields_list_contains,splitkb_aurora_sweep_dongle)
```
